/*
 * Copyright (c) 2023 Custom Split
 *
 * SPDX-License-Identifier: MIT
 */

#include "custom_split.dtsi"

&default_transform {
    col-offset = <7>;
};

&kscan0 {
    // Column pins for right half - matching left side order for proper alignment
    col-gpios
        = <&pro_micro 6 GPIO_ACTIVE_HIGH>   // col_outer -> P6 -> D6
        , <&pro_micro 7 GPIO_ACTIVE_HIGH>   // col_pinky -> P7 -> D7
        , <&pro_micro 8 GPIO_ACTIVE_HIGH>   // col_ring -> P8 -> D8
        , <&pro_micro 9 GPIO_ACTIVE_HIGH>   // col_middle -> P9 -> D9
        , <&pro_micro 10 GPIO_ACTIVE_HIGH>  // col_index -> P10 -> D10
        , <&pro_micro 14 GPIO_ACTIVE_HIGH>  // col_inner -> P14 -> A0
        , <&pro_micro 20 GPIO_ACTIVE_HIGH>  // extra_col -> P20
        ;
};
