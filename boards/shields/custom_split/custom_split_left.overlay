/*
 * Copyright (c) 2023 Custom Split
 *
 * SPDX-License-Identifier: MIT
 */

#include "custom_split.dtsi"

&kscan0 {
    // Column pins for left half based on your Ergogen mapping
    col-gpios
        = <&supermini 6 GPIO_ACTIVE_HIGH>   // col_outer -> P6
        , <&supermini 7 GPIO_ACTIVE_HIGH>   // col_pinky -> P7
        , <&supermini 8 GPIO_ACTIVE_HIGH>   // col_ring -> P8
        , <&supermini 9 GPIO_ACTIVE_HIGH>   // col_middle -> P9
        , <&supermini 10 GPIO_ACTIVE_HIGH>  // col_index -> P10
        , <&supermini 14 GPIO_ACTIVE_HIGH>  // col_inner -> P14
        ;
};