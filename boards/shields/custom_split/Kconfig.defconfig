## boards/shields/custom_split/Kconfig.defconfig
```kconfig
# Copyright (c) 2023 Custom Split
# SPDX-License-Identifier: MIT

if SHIELD_CUSTOM_SPLIT_LEFT

config ZMK_KEYBOARD_NAME
    default "Custom Split"

config ZMK_SPLIT_ROLE_CENTRAL
    default y

endif

if SHIELD_CUSTOM_SPLIT_LEFT || SHIELD_CUSTOM_SPLIT_RIGHT

config ZMK_SPLIT
    default y

endif
```

## boards/shields/custom_split/Kconfig.shield
```kconfig
# Copyright (c) 2023 Custom Split
# SPDX-License-Identifier: MIT

config SHIELD_CUSTOM_SPLIT_LEFT
    def_bool $(shields_list_contains,custom_split_left)

config SHIELD_CUSTOM_SPLIT_RIGHT
    def_bool $(shields_list_contains,custom_split_right)
```

## boards/supermini_nrf52840/supermini_nrf52840_defconfig
```kconfig
# SuperMini nRF52840 board configuration
# Based on Ergogen ceoloide/mcu_supermini_nrf52840

CONFIG_SOC_SERIES_NRF52X=y
CONFIG_SOC_NRF52840_QIAA=y
CONFIG_BOARD_SUPERMINI_NRF52840=y

# Enable MPU
CONFIG_ARM_MPU=y

# enable GPIO
CONFIG_GPIO=y

CONFIG_USE_DT_CODE_PARTITION=y

CONFIG_BUILD_OUTPUT_UF2=y

# Enable 32kHz crystal
CONFIG_CLOCK_CONTROL_NRF_K32SRC_XTAL=y
CONFIG_CLOCK_CONTROL_NRF_K32SRC_30PPM=y
```
